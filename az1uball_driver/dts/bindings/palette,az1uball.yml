## az1uball_driver/dts/bindings/palette,az1uball.yml
```yaml
description: AZ1UBALL trackball sensor

compatible: "palette,az1uball"

include: i2c-device.yaml

properties:
  reg:
    required: true
    description: I2C address of the trackball

  # Axis orientation / scaling (adopted from te9no/zmk-driver-az1uball) so a
  # rotated/mirrored mounting can be corrected from devicetree, no code edit.
  invert-x:
    type: boolean
    description: Negate the X delta.
  invert-y:
    type: boolean
    description: Negate the Y delta.
  swap-xy:
    type: boolean
    description: Swap the X and Y axes (fixes a 90-degree rotated mount).

  no-switch:
    type: boolean
    description: |
      Do not report the ball press as a left click. Set this when the board also
      wires the ball switch into the key matrix, so the keymap (and ZMK Studio)
      owns that binding instead of the driver forcing button 1.
  scale-x:
    type: int
    default: 1
    description: Integer multiplier applied to the X delta after smoothing.
  scale-y:
    type: int
    default: 1
    description: Integer multiplier applied to the Y delta after smoothing.
```

## config/boards/shields/cocot48lp/Kconfig.defconfig
```kconfig
if SHIELD_COCOT48LP

config ZMK_KEYBOARD_NAME
    default "cocot48lp"

config ZMK_SPLIT
    default n

endif
```

## config/boards/shields/cocot48lp/Kconfig.shield
```kconfig
config SHIELD_COCOT48LP
	def_bool $(shields_list_contains,cocot48lp)

config KSCAN_GPIO_DUPLEX_MATRIX
	bool "GPIO duplex matrix keyboard scanner"
	default y
	depends on DT_HAS_ZMK_KSCAN_GPIO_DUPLEX_MATRIX_ENABLED
	select KSCAN
	select ZMK_KSCAN
```
