## config/boards/arm/ble_micro_pro/Kconfig.ble_micro_pro
```kconfig
# hwmv2: this file selects the SoC for the board.
# Selecting SOC_NRF52840_QIAA pulls in SOC_NRF52840 -> SOC_SERIES_NRF52X
# -> SOC_FAMILY_NORDIC_NRF, which sets ARCH, HAS_NRFX, and the Nordic
# clock-control driver (so the K32SRC clock choice becomes valid).
config BOARD_BLE_MICRO_PRO
	select SOC_NRF52840_QIAA if BOARD_BLE_MICRO_PRO_NRF52840
```

## config/boards/arm/ble_micro_pro/board.yml
```yaml
board:
  name: ble_micro_pro
  full_name: BLE Micro Pro
  vendor: sekigon
  socs:
    - name: nrf52840
```

## config/boards/arm/ble_micro_pro_nosd/board.yml
```yaml
board:
  name: ble_micro_pro_nosd
  full_name: BLE Micro Pro (SoftDevice erased)
  vendor: sekigon
  socs:
    - name: nrf52840
```

## config/boards/shields/cocot46lp/Kconfig.defconfig
```kconfig
if SHIELD_COCOT46LP

config ZMK_KEYBOARD_NAME
    default "cocot46lp"

config ZMK_SPLIT
    default n

endif
```

## config/boards/shields/cocot46lp/Kconfig.shield
```kconfig
config SHIELD_COCOT46LP
	def_bool $(shields_list_contains,cocot46lp)

config KSCAN_GPIO_DUPLEX_MATRIX
	bool "GPIO duplex matrix keyboard scanner"
	default y
	depends on DT_HAS_ZMK_KSCAN_GPIO_DUPLEX_MATRIX_ENABLED
	select KSCAN
	select ZMK_KSCAN
```

## config/dts/bindings/zmk,kscan-gpio-duplex-matrix.yaml
```yaml
description: |
  Duplex GPIO matrix keyboard scanner.
  Phase 1 drives each row LOW and senses cols (row2col).
  Phase 2 drives each col LOW and senses rows (col2row).
  Both phases run sequentially so GPIO pins never conflict.

compatible: "zmk,kscan-gpio-duplex-matrix"

properties:
  row-gpios:
    type: phandle-array
    required: true
    description: Row GPIO pins (used as OUTPUT in phase 1, INPUT in phase 2)

  col-gpios:
    type: phandle-array
    required: true
    description: Column GPIO pins (used as INPUT in phase 1, OUTPUT in phase 2)

  poll-period-ms:
    type: int
    default: 10
    description: Polling interval in milliseconds
```

## config/west.yml
```yaml
manifest:
  remotes:
    - name: zmkfirmware
      url-base: https://github.com/zmkfirmware
  projects:
    - name: zmk
      remote: zmkfirmware
      revision: main
      import: app/west.yml
    # AZ1UBALL (PIM447-compatible I2C trackball) input driver is now VENDORED
    # in-tree at ../az1uball_driver (added via -DZMK_EXTRA_MODULES in build.yml)
    # because we patched it to add jitter smoothing. Previously this pulled
    # kzyz/zmk-az1uball-driver as an external module.
  self:
    path: config
```
